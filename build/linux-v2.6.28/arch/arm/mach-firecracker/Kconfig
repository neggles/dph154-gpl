## build/linux-v2.6.28/arch/arm/mach-firecracker/Kconfig
```kconfig
################################################################################
# 
# Copyright (c) 2009 ip.access Ltd.
#
#  This program is free software; you can redistribute  it and/or modify it
#  under  the terms of  the GNU General  Public License as published by the
#  Free Software Foundation;  either version 2 of the  License, or (at your
#  option) any later version.
#
# 22 Apr 2009 Created by Simon D Hughes.
##############################################################################
# Filename: 
##############################################################################
# $picoChipHeaderSubst$

menu "Firecracker platform type"
	depends on ARCH_FIRECRACKER

config MACH_PC72052_I10_REVB
	bool "Support the picoChip PC7202/PC7205 Platforms"
	help
	  Include support for the picoChip PC7202/PC7205 Platforms.

config MACH_PC7802
	bool "Support the picoChip PC7802 Platform"
	help
	  Include support for the picoChip PC7802 Platform.

config IP202FF_XC
	bool "Support IPA changes to XC"
	help
	  Include support for custom changes to the IPA CPE XC Board based on Firecracker REVB.

config FIRECRACKER_DMA_TEST
	bool "Firecracker DMA driver test module (dma_test)"
	help
	  Include the firecracker DMA test module.

config FIRECRACKER_DMA_DEBUG
	int "Firecracker DMA driver debugging verbosity (0 = quiet, 9 = noisy)"
	default "0"
	help
	  This controls the amount of debugging messages produced by the
	  firecracker DMA driver. A value of zero builds a driver without
	  debug code.

config FIRECRACKER_EMAC_DEBUG
	int "Firecracker EMAC driver debugging verbosity (0 = quiet, 9 = noisy)"
	default "0"
	help
	  This controls the amount of debugging messages produced by the
	  firecracker EMAC driver. A value of zero builds a driver without
	  debug code.

config FIRECRACKER_ASYNC_OPROF
    bool "Support async oprofile sampling (Uses Timer 2)"
	help
	  This controls whether to use a separate hardware timer for oprofile
	  sampling rather than the system tick timer.  If this is selected then
	  the oprofile sample rate will eventually gather samples from a range
	  of points within the system tick.

endmenu
```

## build/linux-v2.6.28/arch/arm/mach-pc302/Kconfig
```kconfig
################################################################################
# 
# Copyright (c) 2009 ip.access Ltd.
#
#  This program is free software; you can redistribute  it and/or modify it
#  under  the terms of  the GNU General  Public License as published by the
#  Free Software Foundation;  either version 2 of the  License, or (at your
#  option) any later version.
#
# 22 Apr 2009 Created by Simon D Hughes.
##############################################################################
# Filename: 
##############################################################################
# $picoChipHeaderSubst$

menu "PC302 platform type"
	depends on ARCH_PC302

config MACH_PC7302
	bool "Support PC7302 Board"
	help
          Include support for the picoChip PC7302 platform.
          
config IP302FF_XC
	bool "Support IPA changes to XC"
	help
          Include support for custom changes to the IPA CPE XC Board based on PC7302.

config PC302_ASYNC_OPROF
	bool "Support async oprofile sampling (Uses Timer 2)"
	help
	  This controls whether to use a separate hardware timer for oprofile
	  sampling rather than the system tick timer.  If this is selected then
	  the oprofile sample rate will eventually gather samples from a range
	  of points within the system tick.

endmenu
```

## build/linux-v2.6.28/drivers/dma/Kconfig
```kconfig
#
# DMA engine configuration
#

menuconfig DMADEVICES
	bool "DMA Engine support"
	depends on !HIGHMEM64G && HAS_DMA
	help
	  DMA engines can do asynchronous data transfers without
	  involving the host CPU.  Currently, this framework can be
	  used to offload memory copies in the network stack and
	  RAID operations in the MD driver.  This menu only presents
	  DMA Device drivers supported by the configured arch, it may
	  be empty in some cases.

if DMADEVICES

comment "DMA Devices"

config INTEL_IOATDMA
	tristate "Intel I/OAT DMA support"
	depends on PCI && X86
	select DMA_ENGINE
	select DCA
	help
	  Enable support for the Intel(R) I/OAT DMA engine present
	  in recent Intel Xeon chipsets.

	  Say Y here if you have such a chipset.

	  If unsure, say N.

config INTEL_IOP_ADMA
	tristate "Intel IOP ADMA support"
	depends on ARCH_IOP32X || ARCH_IOP33X || ARCH_IOP13XX
	select DMA_ENGINE
	help
	  Enable support for the Intel(R) IOP Series RAID engines.

config DW_DMAC
	tristate "Synopsys DesignWare AHB DMA support"
	depends on AVR32
	select DMA_ENGINE
	default y if CPU_AT32AP7000
	help
	  Support the Synopsys DesignWare AHB DMA controller.  This
	  can be integrated in chips such as the Atmel AT32ap7000.

config PC302_DMA
    tristate "PC302 DMA support"
    depends on ARCH_PC302
    select DMA_ENGINE
    ---help---
      This driver provides support for the Synopsys DesignWare AHB DMA controllers
      present on the PC302. 

config PC302_DMA_DEBUG_LEVEL
        int "PC302 driver debugging verbosity (0 = quiet, 9 = noisy)"
        default "0"
        depends on PC302_DMA
        help
          This controls the amount of debugging messages produced by the
          PC30x DMA driver. A value of zero builds a driver that has as default
          no debug code.

config FSL_DMA
	tristate "Freescale Elo and Elo Plus DMA support"
	depends on FSL_SOC
	select DMA_ENGINE
	---help---
	  Enable support for the Freescale Elo and Elo Plus DMA controllers.
	  The Elo is the DMA controller on some 82xx and 83xx parts, and the
	  Elo Plus is the DMA controller on 85xx and 86xx parts.

config MV_XOR
	bool "Marvell XOR engine support"
	depends on PLAT_ORION
	select DMA_ENGINE
	---help---
	  Enable support for the Marvell XOR engine.

config DMA_ENGINE
	bool

comment "DMA Clients"
	depends on DMA_ENGINE

config NET_DMA
	bool "Network: TCP receive copy offload"
	depends on DMA_ENGINE && NET
	default (INTEL_IOATDMA || FSL_DMA)
	help
	  This enables the use of DMA engines in the network stack to
	  offload receive copy-to-user operations, freeing CPU cycles.

	  Say Y here if you enabled INTEL_IOATDMA or FSL_DMA, otherwise
	  say N.

config DMATEST
	tristate "DMA Test client"
	depends on DMA_ENGINE
	help
	  Simple DMA test client. Say N unless you're debugging a
	  DMA Device driver.

config PC302_DMA_TEST
    tristate "PC30x DMA test driver"
    depends on PC302_DMA && DMATEST
    ---help---
      This driver provides a number of basic tests for the DMA controllers
      present on the PC302. The tests are run on module load and can be 
      targetted to run on DMAC 0 or 1.

endif
```

## build/linux-v2.6.28/drivers/ipa/Kconfig
```kconfig
################################################################################
# 
# Copyright (c) 2009 ip.access Ltd.
#
#  This program is free software; you can redistribute  it and/or modify it
#  under  the terms of  the GNU General  Public License as published by the
#  Free Software Foundation;  either version 2 of the  License, or (at your
#  option) any later version.
#
# 22 Apr 2009 Created by Simon D Hughes.
##############################################################################
# Filename: 
##############################################################################

#
# IPAccess device drivers
#

menu "IP Access Drivers"

config IPACCESS
    tristate

config IPACCESS_CPETD
    tristate "cpetd support"
    select IPACCESS
    ---help---
      The CPE Timer Device Driver. This device driver is used to give
      fine grained timer ticks to user mode applications e.g. 3g ctrl
      and data apps.

config IPACCESS_DEBUG
    tristate "ipa_debug support"
    select IPACCESS
    ---help---
      Support for the 3GAP FPGA logger card.

config IPACCESS_LED
    tristate "leddriver support"
    select IPACCESS
    ---help---
      Support for the 3GAP ip202ff xbplus & xd leds.

config IPACCESS_CRYPTO
    tristate "crypto offload for IPsec"
    default m
    help
      Enable platform support for using the PicoArray for IPsec 
      crypto and auth offload

config IPACCESS_FPGA_DEBUG
    bool "kernel debug via FPGA"
    ---help---
      This option allows kernel functions and driver modules to output trace
      information to the FPGA debug card.  It also allows access to the hires
      timer maintained by the CPETD.  To enable these functions, both the
      cpetd and ipa_debug driver modules must be loaded, though the kernel will
      still function correctly without them.

endmenu
```

## build/linux-v2.6.28/drivers/perfcounters/Kconfig
```kconfig
# $picoChipHeaderSubst$
#
# performance counter subsystem
#

menuconfig PERFCOUNTERS
    bool "Performance counter subsystem"
    help
      This enables the performance counter subsystem

if PERFCOUNTERS

# ARMv6 Performance counters
config ARMV6_PERFCOUNTER
        tristate "ARMv6 performance counter support"
        depends on CPU_V6 || CPU_32v6K
        default m
        help
          Enable performance counter support for ARMv6 cores.

endif
```

## build/linux-v2.6.28/drivers/picochip/Kconfig
```kconfig
# $picoChipHeaderSubst$
#
# picoChip device drivers
#

menu "picoChip Drivers"

config PICOCHIP
    tristate

config PICOHDP_CPLD
    tristate "HDP CPLD Support"
    depends on PICOHDP || PICOHDP203
    ---help---
      This driver controls periperhals managed via the picoHDP main CPLD

config PICOCPE20X_FPGA
    tristate "CPE20X FPGA Support"
    depends on ARCH_FIRECRACKER && SPI_FIRECRACKER
    ---help---
      This driver exports an interface for accessing the CPE20x FPGAs. 
      The driver uses bit-bashed SPI interface via GPIO pins.
      Note: The kernel uses this driver to implement a hard reset. If
      it is not installed, the kernel will not reset the board.

config PICOIF
    tristate "picoIf driver"
    ---help---
      This driver provides a kernelspace API for accessing picoArray devices
      and a userspace interface through /dev/picoif

config PICOIF_DMAPOOL
    bool "Picoif DMA buffer pooling"
    depends on PICOIF
    ---help---
      This option enables pooling and reuse of a number of DMA coherent memory
      buffers by the transport channels.

config PICOIF_PC203
    bool "PC203 picoIf support"
    select FSL_DMA
    depends on PICOIF && PICOHDP203
    ---help---
      Selecting yes here enables PC203 support in picoIf.

config PICOIF_PC202
    bool "PC202/5 picoIf support"
    depends on PICOIF && ARCH_FIRECRACKER
    ---help---
      Selecting yes here enables PC202 and PC205 support in picoIf.

config PICOIF_PC302
    bool "PC302 picoIf support"
    depends on PICOIF && ARCH_PC302
    ---help---
      Selecting yes here enables PC302 support in picoIf.

config PICOIF_DEFAULT_DEBUG_LEVEL
    int "Default debugging level for the picoIf driver (0 = quiet, 9 = noisy)"
    default "1"
    help
      This sets the default debug verbosity of the driver at load time. The
      values for each component may then be ajusted with the *lvl entries in
      /debug/picoif/.

config PICOIF_DEBUG_TO_CONSOLE
    bool "Print picoIf debug messages to the console"
    default false
    help
      Enabling this causes picoIf debug messages to be printed to the console
      in addition to the debug log in /debug/picoconnect/log. This is mainly
      useful when working on the drivers themselves.

endmenu
```
